int sensorReading = 0;
int speed = 255;
int delayVal = 20000;
int direction1 = 8;
int direction2 = 7;
int kiirus = 9;
int rotationTime = 0;
int kardin = 1;


void setup()
{
    Serial.begin(9600);
pinMode(A0, INPUT);
pinMode(direction2, OUTPUT);
 pinMode(direction1, OUTPUT);
 pinMode(kiirus, OUTPUT);
}

 void loop()
 {
sensorReading = analogRead(A0);
 if (sensorReading < 100) {
   if (kardin == 1) {
  digitalWrite(direction1, HIGH);
  digitalWrite(direction2, LOW);
  analogWrite(kiirus, speed);
  delay(delayVal);
  kardin = 0;
    digitalWrite(direction1, LOW);
  digitalWrite(direction2, LOW);
  analogWrite(kiirus, speed);
  delay(delayVal);
 } }else {
  if (kardin == 0) {
  digitalWrite(direction1, LOW);
  digitalWrite(direction2, HIGH);
  analogWrite(kiirus, speed);
  delay(delayVal);
   kardin = 1;
       digitalWrite(direction1, LOW);
  digitalWrite(direction2, LOW);
  analogWrite(kiirus, speed);
  delay(delayVal);
 } }
 delay(1);
}